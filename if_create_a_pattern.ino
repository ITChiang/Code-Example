#include <Adafruit_TCS34725.h>

#include <FastLED.h>

// Distance Sensor Setup
#define DIST_TRIG A1

// Color Detection Setup
#define PIN_SHINE 8
#define R_UPPER_BOUND 0.34
#define R_LOWER_BOUND 0.18
#define G_UPPER_BOUND 0.39
#define G_LOWER_BOUND 0.22
#define B_UPPER_BOUND 0.43
#define B_LOWER_BOUND 0.2
#define EQUAL_BOUND 0.3

// ### Color Sensor Setting ###
Adafruit_TCS34725 tcs = Adafruit_TCS34725(TCS34725_INTEGRATIONTIME_700MS, TCS34725_GAIN_1X);

// LED Setup 
#define LED_PIN  6
#define COLOR_ORDER GRB
#define CHIPSET     WS2812
#define BRIGHTNESS 64

// Helper functions for an two-dimensional XY matrix of pixels.
// Simple 2-D demo code is included as well.
//
//     XY(x,y) takes x and y coordinates and returns an LED index number,
//             for use like this:  leds[ XY(x,y) ] == CRGB::Red;
//             No error checking is performed on the ranges of x and y.
//
//     XYsafe(x,y) takes x and y coordinates and returns an LED index number,
//             for use like this:  leds[ XY(x,y) ] == CRGB::Red;
//             Error checking IS performed on the ranges of x and y, and an
//             index of "-1" is returned.  Special instructions below
//             explain how to use this without having to do your own error
//             checking every time you use this function.  
//             This is a slightly more advanced technique, and 
//             it REQUIRES SPECIAL ADDITIONAL setup, described below.


// Params for width and height
const uint8_t kMatrixWidth = 22;
const uint8_t kMatrixHeight = 22;






//--------

const byte numChars = 102;
char receivedChars[numChars];   // an array to store the received data from UNITY
boolean newData = false;
long twoDLeds [10][10];

//--------


// Param for different pixel layouts
const bool kMatrixSerpentineLayout = true;
// Set 'kMatrixSerpentineLayout' to false if your pixels are 
// laid out all running the same way, like this:
//
//     0 >  1 >  2 >  3 >  4
//                         |
//     .----<----<----<----'
//     |
//     5 >  6 >  7 >  8 >  9
//                         |
//     .----<----<----<----'
//     |
//    10 > 11 > 12 > 13 > 14
//                         |
//     .----<----<----<----'
//     |
//    15 > 16 > 17 > 18 > 19
//
// Set 'kMatrixSerpentineLayout' to true if your pixels are 
// laid out back-and-forth, like this:
//
//     0 >  1 >  2 >  3 >  4
//                         |
//                         |
//     9 <  8 <  7 <  6 <  5
//     |
//     |
//    10 > 11 > 12 > 13 > 14
//                        |
//                        |
//    19 < 18 < 17 < 16 < 15
//
// Bonus vocabulary word: anything that goes one way 
// in one row, and then backwards in the next row, and so on
// is call "boustrophedon", meaning "as the ox plows."


// This function will return the right 'led index number' for 
// a given set of X and Y coordinates on your matrix.  
// IT DOES NOT CHECK THE COORDINATE BOUNDARIES.  
// That's up to you.  Don't pass it bogus values.
//
// Use the "XY" function like this:
//
//    for( uint8_t x = 0; x < kMatrixWidth; x++) {
//      for( uint8_t y = 0; y < kMatrixHeight; y++) {
//      
//        // Here's the x, y to 'led index' in action: 
//        leds[ XY( x, y) ] = CHSV( random8(), 255, 255);
//      
//      }
//    }
//
//


uint16_t XY( uint8_t x, uint8_t y)
{
  uint16_t i;
  
  if( kMatrixSerpentineLayout == false) {
    i = (y * kMatrixWidth) + x;
    
  }

  if( kMatrixSerpentineLayout == true) {
    if( y & 0x01) {
      // Odd rows run backwards
      uint8_t reverseX = (kMatrixWidth - 1) - x;
      i = (y * kMatrixWidth) + reverseX;
    } else {
      // Even rows run forwards
      i = (y * kMatrixWidth) + x;
    }
  }
  
  return i;
}


// Once you've gotten the basics working (AND NOT UNTIL THEN!)
// here's a helpful technique that can be tricky to set up, but 
// then helps you avoid the needs for sprinkling array-bound-checking
// throughout your code.
//
// It requires a careful attention to get it set up correctly, but
// can potentially make your code smaller and faster.
//
// Suppose you have an 8 x 5 matrix of 40 LEDs.  Normally, you'd
// delcare your leds array like this:
//    CRGB leds[40];
// But instead of that, declare an LED buffer with one extra pixel in
// it, "leds_plus_safety_pixel".  Then declare "leds" as a pointer to
// that array, but starting with the 2nd element (id=1) of that array: 
//    CRGB leds_with_safety_pixel[41];
//    CRGB* const leds( leds_plus_safety_pixel + 1);
// Then you use the "leds" array as you normally would.
// Now "leds[0..N]" are aliases for "leds_plus_safety_pixel[1..(N+1)]",
// AND leds[-1] is now a legitimate and safe alias for leds_plus_safety_pixel[0].
// leds_plus_safety_pixel[0] aka leds[-1] is now your "safety pixel".
//
// Now instead of using the XY function above, use the one below, "XYsafe".
//
// If the X and Y values are 'in bounds', this function will return an index
// into the visible led array, same as "XY" does.
// HOWEVER -- and this is the trick -- if the X or Y values
// are out of bounds, this function will return an index of -1.
// And since leds[-1] is actually just an alias for leds_plus_safety_pixel[0],
// it's a totally safe and legal place to access.  And since the 'safety pixel'
// falls 'outside' the visible part of the LED array, anything you write 
// there is hidden from view automatically.
// Thus, this line of code is totally safe, regardless of the actual size of
// your matrix:
//    leds[ XYsafe( random8(), random8() ) ] = CHSV( random8(), 255, 255);
//
// The only catch here is that while this makes it safe to read from and
// write to 'any pixel', there's really only ONE 'safety pixel'.  No matter
// what out-of-bounds coordinates you write to, you'll really be writing to
// that one safety pixel.  And if you try to READ from the safety pixel,
// you'll read whatever was written there last, reglardless of what coordinates
// were supplied.

#define NUM_LEDS (kMatrixWidth * kMatrixHeight)
CRGB leds_plus_safety_pixel[ NUM_LEDS + 1];
CRGB* const leds( leds_plus_safety_pixel + 1);

uint16_t XYsafe( uint8_t x, uint8_t y)
{
  if( x >= kMatrixWidth) return -1;
  if( y >= kMatrixHeight) return -1;
  return XY(x,y);
}

 const long DigPic0[] PROGMEM =
 { 0x0, 0x0, 0x0, 0x0, 0x0, 0x0, 0x0, 0x0, 0x0, 0x0, 0x0, 0x0, 0x0,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 0x0, 0x0 };
 const long DigPic1[] PROGMEM =  
  { 0x0, 0x0, 0x0, 0x0, 0x0, 0x0, 0x0, 0x0, 0x0, 0x0, 0x0, 0x0, 0x0,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 0x0, 0x0 };
  const long DigPic2[] PROGMEM = 
   { 0x0, 0x0, 0x0, 0x0, 0x0, 0x0, 0x0, 0x0, 0x0, 0x0, 0x0, 0x0, 0x0,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 0x0, 0x0 };
  const long DigPic3[] PROGMEM = 
   { 0x0, 0x0, 0x0, 0x0, 0x0, 0x0, 0x0, 0x0, 0x0, 0x0, 0x0, 0x0, 0x0,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 0x0, 0x0 };
  const long DigPic4[] PROGMEM = 
 { 0x0, 0x0, 0x0, 0x0, 0x0, 0x0, 0x0, 0x0, 0x0, 0x0, 0x0, 0x0, 0x0,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 0x0, 0x0 };
 
// added for merging distance and LED by Leo<tingshel@andrew.cmu.edu>
enum Stage {welcome1, welcome2, welcome3, play};

float dist_cm;
float pre_dist_cm = 1000;
uint8_t loopCount = 0;
bool observe = false;
float duration ;



void setup() {
  Serial.begin(9600);
  
  // ### Setup Distance Sensor ###
  pinMode (DIST_TRIG, INPUT);
 
  // ### Setup Color Sensor ###
  pinMode(PIN_SHINE, OUTPUT);
  digitalWrite(PIN_SHINE, HIGH);
  // delay(10);  // give pull-ups time raise the input voltage
  if (tcs.begin()) Serial.println("Found sensor");
  else             Serial.println("No TCS34725 found … check your connections");
  // set persistence filter to generate an interrupt for every RGB Cycle, regardless of the integration limits
     tcs.write8(TCS34725_PERS, TCS34725_PERS_NONE);
     tcs.setInterrupt(HIGH);

  // ### Setup LED ###
  FastLED.addLeds<CHIPSET, LED_PIN, COLOR_ORDER>(leds, NUM_LEDS).setCorrection(TypicalSMD5050);
  FastLED.setBrightness( BRIGHTNESS );
  Serial.println("<Arduino is ready>");
}


//-----------------------------------------------------------------------------------


uint16_t get_gp2y0a02 (uint16_t value) {
        if (value < 70)  value = 70;
        return 12777.3/value-1.1;        //(cm)
        //return (62.5/(value/1023.0*5)-1.1);        //(cm)
        //return ((67870.0 / (value - 3.0)) - 40.0); //gp2d12 (mm)
}

uint16_t measureDistance() {
  uint16_t value = analogRead (DIST_TRIG);
  uint16_t range = get_gp2y0a02 (value);
  return range;
}

 
void getRawColorData_noDelay(uint16_t *r, uint16_t *g, uint16_t *b, uint16_t *c)
{
  *c = tcs.read16(TCS34725_CDATAL);
  *r = tcs.read16(TCS34725_RDATAL);
  *g = tcs.read16(TCS34725_GDATAL);
  *b = tcs.read16(TCS34725_BDATAL);
}
 
uint8_t* getRGB() {
  uint16_t r, g, b, c;
  getRawColorData_noDelay(&r, &g, &b, &c);

  bool notWhite = true;
  float percentage_rgb[4];
  uint8_t* RGB;
  RGB = (uint8_t*) malloc (3);

  percentage_rgb[0] = r * 0.8; // LED on sensor is lightly yellow
  percentage_rgb[1] = g * 0.85;
  percentage_rgb[2] = b;
  percentage_rgb[3] = percentage_rgb[0] + percentage_rgb[1] + percentage_rgb[2];
  percentage_rgb[0] /= percentage_rgb[3];
  percentage_rgb[1] /= percentage_rgb[3];
  percentage_rgb[2] /= percentage_rgb[3];

  if (percentage_rgb[2] > B_UPPER_BOUND) {
    RGB[2] = 255;
  } else if (percentage_rgb[2] < B_LOWER_BOUND) {
    RGB[2] = 0;
  } else {
    if (percentage_rgb[0] > EQUAL_BOUND && percentage_rgb[1] > EQUAL_BOUND && percentage_rgb[2] > EQUAL_BOUND) {
      RGB[0] = 255;
      RGB[1] = 255;
      RGB[2] = 255;
      notWhite = false;
    } else{
      RGB[2] = 255 * (percentage_rgb[2] - B_LOWER_BOUND) / (B_UPPER_BOUND - B_LOWER_BOUND);
    }
  }
  if (notWhite) {
    if (percentage_rgb[1] > G_UPPER_BOUND) {
      RGB[1] = 255;
    } else if (percentage_rgb[1] < G_LOWER_BOUND) {
      RGB[1] = 0;
    } else {
      RGB[1] = 255 * (percentage_rgb[1] - G_LOWER_BOUND) / (G_UPPER_BOUND - G_LOWER_BOUND);
    }
    
    if (percentage_rgb[0] > R_UPPER_BOUND) {
      RGB[0] = 255;
    } else if (percentage_rgb[0] < R_LOWER_BOUND) {
      RGB[0] = 0;
    } else {
      RGB[0] = 255 * (percentage_rgb[0] - R_LOWER_BOUND) / (R_UPPER_BOUND - R_LOWER_BOUND);
    }
  }

  tcs.clearInterrupt();

  return RGB;
}
 
void recvWithEndMarker() {
  static byte ndx = 0;
  char endMarker = '\n';
  char rc;
 
  while (Serial.available() > 0 && newData == false) {
    rc = Serial.read();
    if (rc != endMarker) {
        receivedChars[ndx] = rc;
        ndx++;
        if (ndx >= numChars) {
            ndx = numChars - 1;
        }
    }
    else {
      receivedChars[ndx] = '\0'; // terminate the string
      ndx = 0;
      newData = true;
    }
  }
}


void showNewData() {
  if (newData == true) {
    
    for(int i =0;i<numChars;i++) {
    
    }
    Serial.println(receivedChars);
    newData = false;
    FastLED.clear();
    switch (receivedChars[0]) {
      case 'a':
      ledPrinter2(0,1,44);
      break;
      case 'b':
      ledPrinter(132,1,43); 
      ledPrinter(144,25,19); 
      break;
      case 'c':
      ledPrinter(0,1,43);
      ledPrinter(12,25,19);
      ledPrinter(270,13,31);
      break;
      case 'd':
      ledPrinter(264,1,43);
      ledPrinter(276,25,19); 
      ledPrinter(0,1,43); 
      ledPrinter(12,25,19);
      
      break;
      
      }

    FastLED.show();                                                                               
  }
}


void ledPrinter(int startPos,int eachDis1, int eachDis2) // startPos the point which start, Ascending powers,Descending powers
{
  int tmp =  startPos;
  int ledCounter = 1; // change from 0 -> 1 04082020 by I-Tung 
  for(int i = 0; i < 10; i++)
  {
    for(int j  = 9; j > -1; j--) 
    {
      if(i%2==0)
      {
        leds[tmp+j] = ledDecoder(receivedChars[ledCounter]);
        ledCounter+=1;
      }
      else
      {
        leds[tmp-j] = ledDecoder(receivedChars[ledCounter]);
        ledCounter+=1;
      }      
    }

    if(i%2==1)
    {
      tmp+=eachDis1;
    }
    else
    {
      tmp+=eachDis2;
    }
  }
}

void ledPrinter2(int startPos,int eachDis1, int eachDis2) // startPos the point which start, Ascending powers,Descending powers
{
  int tmp =  startPos;
  int tmp2 = 43;
  int ledCounter = 1; // change from 0 -> 1 04082020 by I-Tung 
  for(int i = 0; i < 20; i+=2)
  {
    for(int j  = 19; j > -1; j-=2) 
    {
      if(i%2==0)
      {
        leds[tmp+j] = ledDecoder(receivedChars[ledCounter]);
        leds[tmp+j-1] = ledDecoder(receivedChars[ledCounter]);
        //----------------------------------------------------
        leds[tmp2-j] = ledDecoder(receivedChars[ledCounter]);
        leds[tmp2-j+1] = ledDecoder(receivedChars[ledCounter]);
        ledCounter+=1;
      }
      else
      {
        leds[tmp-j] = ledDecoder(receivedChars[ledCounter]);
        leds[tmp-j+1] = ledDecoder(receivedChars[ledCounter]);
        ledCounter+=1;
      }      
    }

    if(i%2==1)
    {
      tmp+=eachDis1;
    }
    else
    {
      tmp+=eachDis2;
      tmp2+=eachDis2;
    }
  }
}


long ledDecoder(char _char){ // translate num to color code
  switch (_char) {
    case '0':
      return 0x000000; //None Color / black
    case '1':
      return 0xFF0000; //Red
    case '2':
      return 0x0000FF; //Blue
    case '3':
      return 0x00FF00; //Green
    case '4':
      return 0xFFFAFA; //white light
    case '5':
      return 0xFFFF00; //Yellow
    case '6':
      return 0xFF00FF; //Purple
    case '7':
      return 0x00FFFF; //LightBlue
  }
}

void ledDisplay(const long dis[])
{

FastLED.clear();
for(int i = 0; i < NUM_LEDS; i++) {
    leds[i] = CRGB(pgm_read_dword(&(dis[i])), 0, 0);
  }

FastLED.show();
FastLED.clear();
delay(10);


}
//--------- 

bool isPlaying = false;
unsigned int loop_play = 0;
uint8_t state = 3;

//---------
void loop()
{
  uint16_t dist = measureDistance();

  if (isPlaying) {
    loop_play++;
    if (dist <= 50) {
      loop_play = 0;
    }
    if (loop_play > 100) { // how long the play state lasts
      isPlaying = false;
      state = (dist - 35) / 15;
      loop_play = 0;
    }
    
  } else {
    if (dist < 50) {
      loop_play = 0;
      state = 0;
    } else {
      state = (dist - 17) / 33;
    }
  }

  switch (state) {
    case 0:
      if (!isPlaying) {
        ledDisplay(DigPic4);
        isPlaying = true;
      }
      recvWithEndMarker();
      showNewData();
      break;
    case 1:
      ledDisplay(DigPic3);
      break;
    case 2:
      ledDisplay(DigPic2);
      break;
    case 3:
      ledDisplay(DigPic1);
      break;
    default:
      ledDisplay(DigPic0);
      break;
      
  }
}
